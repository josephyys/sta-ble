## CMakeLists.txt
```
#
# Copyright (c) 2022 Nordic Semiconductor ASA
#
# SPDX-License-Identifier: LicenseRef-Nordic-5-Clause
#

cmake_minimum_required(VERSION 3.20.0)

find_package(Zephyr REQUIRED HINTS $ENV{ZEPHYR_BASE})
project(nrf_wifi_shell)

target_sources_ifdef(CONFIG_NRF70_RAW_DATA_TX
	app
	PRIVATE
	src/wifi_raw_tx_pkt_shell.c)

target_sources_ifdef(CONFIG_NRF70_PROMISC_DATA_RX
	app
	PRIVATE
	src/wifi_promiscuous_shell.c)

target_sources(app PRIVATE src/main.c src/at_commands.c src/at_shell_commands.c)
```

## sysbuild.conf
```
#
# Copyright (c) 2024 Nordic Semiconductor ASA
#
# SPDX-License-Identifier: LicenseRef-Nordic-5-Clause
#

SB_CONFIG_WIFI_NRF70=y

# Enable network core for Bluetooth
SB_CONFIG_NETCORE_HCI_IPC=y
```

## prj.conf
```kconfig
#
# Copyright (c) 2022 Nordic Semiconductor ASA
#
# SPDX-License-Identifier: LicenseRef-Nordic-5-Clause
#
CONFIG_WIFI=y
CONFIG_WIFI_NRF70=y

# WPA supplicant
CONFIG_WIFI_NM_WPA_SUPPLICANT=y
CONFIG_NET_L2_WIFI_SHELL=y

# Networking
CONFIG_NETWORKING=y
CONFIG_NET_SOCKETS=y
CONFIG_NET_LOG=y
# Disable IPv6 to focus on IPv4 only
# CONFIG_NET_IPV6=y
CONFIG_NET_IPV6=n
CONFIG_NET_IPV4=y
CONFIG_NET_UDP=y
CONFIG_NET_TCP=y
CONFIG_NET_DHCPV4=y
CONFIG_DNS_RESOLVER=y

CONFIG_NET_STATISTICS=y
CONFIG_NET_STATISTICS_WIFI=y
CONFIG_NET_STATISTICS_USER_API=y

CONFIG_NET_PKT_RX_COUNT=8
CONFIG_NET_PKT_TX_COUNT=8

# Below section is the primary contributor to SRAM and is currently
# tuned for performance, but this will be revisited in the future.
CONFIG_NET_BUF_RX_COUNT=16
CONFIG_NET_BUF_TX_COUNT=16
CONFIG_NRF70_RX_NUM_BUFS=16
CONFIG_NRF70_MAX_TX_AGGREGATION=4
CONFIG_NET_TC_TX_COUNT=1

CONFIG_NET_IF_UNICAST_IPV6_ADDR_COUNT=4
CONFIG_NET_IF_MCAST_IPV6_ADDR_COUNT=5
CONFIG_NET_MAX_CONTEXTS=5
CONFIG_NET_CONTEXT_SYNC_RECV=y

CONFIG_INIT_STACKS=y

CONFIG_NET_L2_ETHERNET=y
CONFIG_NET_SHELL=y

# AT Command interface for NUC980
CONFIG_HTTP_CLIENT=y
CONFIG_NET_SOCKETS_SOCKOPT_TLS=y
CONFIG_NET_SOCKETS_ENABLE_DTLS=y

# Increase network buffers for HTTP requests
CONFIG_NET_PKT_RX_COUNT=16
CONFIG_NET_PKT_TX_COUNT=16
CONFIG_NET_BUF_RX_COUNT=32
CONFIG_NET_BUF_TX_COUNT=32

# Enable routing support (required for gateway)
CONFIG_NET_NATIVE=y
# CONFIG_NET_ROUTE=y
CONFIG_NET_ROUTE_MCAST=y
# CONFIG_NET_IPV4_ROUTE=y

# Fix DHCP gateway configuration  
CONFIG_NET_DHCPV4_OPTION_CALLBACKS=y

# Memories
CONFIG_MAIN_STACK_SIZE=5200
CONFIG_SHELL_STACK_SIZE=5400

CONFIG_NET_TX_STACK_SIZE=4096
CONFIG_NET_RX_STACK_SIZE=4096

# Debugging
CONFIG_STACK_SENTINEL=y
CONFIG_DEBUG_COREDUMP=y
CONFIG_DEBUG_COREDUMP_BACKEND_LOGGING=y
CONFIG_DEBUG_COREDUMP_MEMORY_DUMP_MIN=y
CONFIG_SHELL_CMDS_RESIZE=n
#CONFIG_DEBUG=y
CONFIG_WIFI_NM_WPA_SUPPLICANT_LOG_LEVEL_INF=y

# Kernel options
CONFIG_ENTROPY_GENERATOR=y
CONFIG_REBOOT=y

# # Bluetooth LE support
# CONFIG_BT=y
# CONFIG_BT_CENTRAL=y
# CONFIG_BT_OBSERVER=y
# CONFIG_BT_SHELL=y
# CONFIG_BT_DEVICE_NAME="nRF7002DK"
# CONFIG_BT_MAX_CONN=1
# CONFIG_BT_HCI=y
# CONFIG_BT_RPMSG=y


# nRF5340 specific - IPC support
CONFIG_IPC_SERVICE=y
CONFIG_MBOX=y
CONFIG_HEAP_MEM_POOL_SIZE=2048

# Logging
CONFIG_LOG=y
CONFIG_PRINTK=y
CONFIG_SHELL=y
CONFIG_SHELL_GETOPT=y
CONFIG_DEVICE_SHELL=y
CONFIG_POSIX_TIMERS=y
CONFIG_DATE_SHELL=y
CONFIG_NET_CONFIG_AUTO_INIT=n
CONFIG_POSIX_API=y

CONFIG_WIFI_CREDENTIALS=y
CONFIG_FLASH=y
CONFIG_FLASH_PAGE_LAYOUT=y
CONFIG_FLASH_MAP=y
CONFIG_NVS=y
CONFIG_SETTINGS=y
CONFIG_SETTINGS_NVS=y

# printing of scan results puts pressure on queues in new locking
# design in net_mgmt. So, use a higher timeout for a crowded
# environment.
CONFIG_NET_MGMT_EVENT_QUEUE_TIMEOUT=5000
CONFIG_NET_SOCKETS_POLL_MAX=12
CONFIG_NET_MGMT_EVENT_QUEUE_SIZE=16
```

## overlay-slip.conf
```kconfig
CONFIG_NET_DRIVERS=y
CONFIG_SLIP=y
CONFIG_SLIP_TAP=y
CONFIG_SLIP_MAC_ADDR="00:00:00:00:00:01"

# Shell should be disabled for SLIP to work
CONFIG_NET_L2_WIFI_SHELL=n
CONFIG_NET_L2_WIFI_MGMT=y
CONFIG_NET_SHELL=n
CONFIG_DEVICE_SHELL=n
CONFIG_DATE_SHELL=n
CONFIG_SHELL=n
CONFIG_LOG=n
CONFIG_PRINTK=n
```

## src/main.c
```c
/*
 * Copyright (c) 2022 Nordic Semiconductor ASA
 *
 * SPDX-License-Identifier: LicenseRef-Nordic-5-Clause
 */

/** @file
 * @brief WiFi shell sample main function
 */

#include <zephyr/sys/printk.h>
#include <zephyr/kernel.h>
#if NRFX_CLOCK_ENABLED && (defined(CLOCK_FEATURE_HFCLK_DIVIDE_PRESENT) || NRF_CLOCK_HAS_HFCLK192M)
#include <nrfx_clock.h>
#endif
#include <zephyr/device.h>
#include <zephyr/net/net_config.h>

#if defined(CONFIG_USB_DEVICE_STACK) && !defined(CONFIG_BOARD_THINGY91X_NRF5340_CPUAPP)
#define USES_USB_ETH 1
#else
#define USES_USB_ETH 0
#endif

#if USES_USB_ETH
#include <zephyr/usb/usb_device.h>
#endif

#if USES_USB_ETH || defined(CONFIG_SLIP)
static struct in_addr addr = { { { 192, 0, 2, 1 } } };
static struct in_addr mask = { { { 255, 255, 255, 0 } } };
#endif /* CONFIG_USB_DEVICE_STACK || CONFIG_SLIP */

#if USES_USB_ETH
int init_usb(void)
{
	int ret;

	ret = usb_enable(NULL);
	if (ret != 0) {
		printk("Cannot enable USB (%d)", ret);
		return ret;
	}

	return 0;
}
#endif


int main(void)
{
#if NRFX_CLOCK_ENABLED && (defined(CLOCK_FEATURE_HFCLK_DIVIDE_PRESENT) || NRF_CLOCK_HAS_HFCLK192M)
	/* For now hardcode to 128MHz */
	nrfx_clock_divider_set(NRF_CLOCK_DOMAIN_HFCLK,
			       NRF_CLOCK_HFCLK_DIV_1);
#endif
	printk("Starting %s with CPU frequency: %d MHz\n", CONFIG_BOARD, SystemCoreClock/MHZ(1));

#if USES_USB_ETH
	init_usb();

	/* Redirect static IP address to netusb*/
	const struct device *usb_dev = device_get_binding("eth_netusb");
	struct net_if *iface = net_if_lookup_by_dev(usb_dev);

	if (!iface) {
		printk("Cannot find network interface: %s", "eth_netusb");
		return -1;
	}

	net_if_ipv4_addr_add(iface, &addr, NET_ADDR_MANUAL, 0);
	net_if_ipv4_set_netmask_by_addr(iface, &addr, &mask);
#endif

#ifdef CONFIG_SLIP
	const struct device *slip_dev = device_get_binding(CONFIG_SLIP_DRV_NAME);
	struct net_if *slip_iface = net_if_lookup_by_dev(slip_dev);

	if (!slip_iface) {
		printk("Cannot find network interface: %s", CONFIG_SLIP_DRV_NAME);
		return -1;
	}

	net_if_ipv4_addr_add(slip_iface, &addr, NET_ADDR_MANUAL, 0);
	net_if_ipv4_set_netmask_by_addr(slip_iface, &addr, &mask);
#endif /* CONFIG_SLIP */

#ifdef CONFIG_NET_CONFIG_SETTINGS
	/* Without this, DHCPv4 starts on first interface and if that is not Wi-Fi or
	 * only supports IPv6, then its an issue. (E.g., OpenThread)
	 *
	 * So, we start DHCPv4 on Wi-Fi interface always, independent of the ordering.
	 */
	const struct device *dev = DEVICE_DT_GET(DT_CHOSEN(zephyr_wifi));
	struct net_if *wifi_iface = net_if_lookup_by_dev(dev);

	/* As both are Ethernet, we need to set specific interface*/
	net_if_set_default(wifi_iface);

	net_config_init_app(dev, "Initializing network");
#endif

	/* Initialize AT command interface for NUC980 */
	/* extern int at_commands_init(void);
	at_commands_init(); */

	return 0;
}
```

## src/at_commands.c
```c
/*
 * AT Command Interface for NUC980 Communication
 * Provides network services via UART AT commands
 */

#include <zephyr/kernel.h>
#include <zephyr/device.h>
#include <zephyr/drivers/uart.h>
#include <zephyr/net/net_if.h>
#include <zephyr/net/wifi_mgmt.h>
#include <zephyr/net/socket.h>
#include <zephyr/net/http/client.h>
#include <string.h>
#include <stdio.h>

#define AT_CMD_BUFFER_SIZE 256
#define AT_RESPONSE_BUFFER_SIZE 1024

static char at_cmd_buffer[AT_CMD_BUFFER_SIZE];
static char at_response_buffer[AT_RESPONSE_BUFFER_SIZE];
static int at_cmd_pos = 0;
static const struct device *at_uart;

/* AT Command responses */
#define AT_OK "OK\r\n"
#define AT_ERROR "ERROR\r\n"
#define AT_READY "+READY\r\n"

/* Function declarations */
static void at_send_response(const char *response);
static void at_process_command(const char *cmd);
static void at_cmd_wifi_connect(const char *ssid, const char *password);
static void at_cmd_wifi_status(void);
static void at_cmd_http_get(const char *url);

/* Send AT response to NUC980 */
static void at_send_response(const char *response)
{
    if (!at_uart) return;
    
    for (int i = 0; response[i]; i++) {
        uart_poll_out(at_uart, response[i]);
    }
}

/* WiFi Connect Command: AT+WIFICONN=ssid,password */
static void at_cmd_wifi_connect(const char *ssid, const char *password)
{
    struct net_if *iface = net_if_get_first_wifi();
    if (!iface) {
        at_send_response(AT_ERROR);
        return;
    }
    
    struct wifi_connect_req_params params = {
        .ssid = ssid,
        .ssid_length = strlen(ssid),
        .psk = password,
        .psk_length = strlen(password),
        .security = WIFI_SECURITY_TYPE_PSK,
        .channel = WIFI_CHANNEL_ANY,
    };
    
    int ret = net_mgmt(NET_REQUEST_WIFI_CONNECT, iface, &params, sizeof(params));
    if (ret == 0) {
        at_send_response("+WIFICONN:CONNECTING\r\n");
        at_send_response(AT_OK);
    } else {
        at_send_response(AT_ERROR);
    }
}

/* WiFi Status Command: AT+WIFISTATUS */
static void at_cmd_wifi_status(void)
{
    struct net_if *iface = net_if_get_first_wifi();
    if (!iface) {
        at_send_response(AT_ERROR);
        return;
    }
    
    struct wifi_iface_status status = {0};
    int ret = net_mgmt(NET_REQUEST_WIFI_IFACE_STATUS, iface, &status, sizeof(status));
    
    if (ret == 0) {
        if (status.state >= WIFI_STATE_ASSOCIATED) {
            snprintf(at_response_buffer, sizeof(at_response_buffer),
                    "+WIFISTATUS:CONNECTED,%s,%d\r\n", status.ssid, status.rssi);
        } else {
            snprintf(at_response_buffer, sizeof(at_response_buffer),
                    "+WIFISTATUS:DISCONNECTED\r\n");
        }
        at_send_response(at_response_buffer);
        at_send_response(AT_OK);
    } else {
        at_send_response(AT_ERROR);
    }
}

/* HTTP GET Command: AT+HTTPGET=url */
static void at_cmd_http_get(const char *url)
{
    /* Simple HTTP GET implementation */
    int sock;
    struct sockaddr_in addr;
    char request[512];
    char response[1024];
    
    /* Parse URL to get host and path */
    char host[128] = {0};
    char path[256] = "/";
    
    /* Simple URL parsing - assumes http://host/path format */
    if (strncmp(url, "http://", 7) == 0) {
        const char *host_start = url + 7;
        const char *path_start = strchr(host_start, '/');
        
        if (path_start) {
            strncpy(host, host_start, path_start - host_start);
            strncpy(path, path_start, sizeof(path) - 1);
        } else {
            strncpy(host, host_start, sizeof(host) - 1);
        }
    } else {
        at_send_response(AT_ERROR);
        return;
    }
    
    /* Create socket */
    sock = socket(AF_INET, SOCK_STREAM, IPPROTO_TCP);
    if (sock < 0) {
        at_send_response(AT_ERROR);
        return;
    }
    
    /* Resolve hostname (simplified - assumes IP address) */
    addr.sin_family = AF_INET;
    addr.sin_port = htons(80);
    
    /* For demo, use a simple IP resolution */
    if (inet_pton(AF_INET, host, &addr.sin_addr) <= 0) {
        /* If not IP, try to resolve - simplified for demo */
        close(sock);
        at_send_response("+HTTPGET:DNS_FAILED\r\n");
        at_send_response(AT_ERROR);
        return;
    }
    
    /* Connect */
    if (connect(sock, (struct sockaddr *)&addr, sizeof(addr)) < 0) {
        close(sock);
        at_send_response("+HTTPGET:CONNECT_FAILED\r\n");
        at_send_response(AT_ERROR);
        return;
    }
    
    /* Send HTTP request */
    snprintf(request, sizeof(request),
            "GET %s HTTP/1.1\r\n"
            "Host: %s\r\n"
            "Connection: close\r\n"
            "\r\n", path, host);
    
    if (send(sock, request, strlen(request), 0) < 0) {
        close(sock);
        at_send_response(AT_ERROR);
        return;
    }
    
    /* Receive response */
    int bytes = recv(sock, response, sizeof(response) - 1, 0);
    close(sock);
    
    if (bytes > 0) {
        response[bytes] = '\0';
        
        /* Send response header */
        at_send_response("+HTTPGET:200,");
        
        /* Send data length */
        snprintf(at_response_buffer, sizeof(at_response_buffer), "%d\r\n", bytes);
        at_send_response(at_response_buffer);
        
        /* Send actual data (truncated for demo) */
        at_send_response(response);
        at_send_response("\r\n");
        at_send_response(AT_OK);
    } else {
        at_send_response(AT_ERROR);
    }
}

/* Process AT command */
static void at_process_command(const char *cmd)
{
    if (strncmp(cmd, "AT", 2) == 0) {
        if (strlen(cmd) == 2) {
            /* Basic AT command */
            at_send_response(AT_OK);
        }
        else if (strncmp(cmd, "AT+WIFICONN=", 12) == 0) {
            /* Parse SSID and password */
            char ssid[64], password[64];
            if (sscanf(cmd + 12, "%63[^,],%63s", ssid, password) == 2) {
                at_cmd_wifi_connect(ssid, password);
            } else {
                at_send_response(AT_ERROR);
            }
        }
        else if (strcmp(cmd, "AT+WIFISTATUS") == 0) {
            at_cmd_wifi_status();
        }
        else if (strncmp(cmd, "AT+HTTPGET=", 11) == 0) {
            at_cmd_http_get(cmd + 11);
        }
        else if (strcmp(cmd, "AT+HELP") == 0) {
            at_send_response("+HELP:Available commands\r\n");
            at_send_response("AT - Test command\r\n");
            at_send_response("AT+WIFICONN=ssid,password - Connect to WiFi\r\n");
            at_send_response("AT+WIFISTATUS - Get WiFi status\r\n");
            at_send_response("AT+HTTPGET=url - HTTP GET request\r\n");
            at_send_response(AT_OK);
        }
        else {
            at_send_response(AT_ERROR);
        }
    } else {
        at_send_response(AT_ERROR);
    }
}

/* UART interrupt handler for AT commands */
static void at_uart_callback(const struct device *dev, void *user_data)
{
    uint8_t c;
    
    if (!uart_irq_update(dev)) {
        return;
    }
    
    if (!uart_irq_rx_ready(dev)) {
        return;
    }
    
    while (uart_fifo_read(dev, &c, 1) == 1) {
        if (c == '\r' || c == '\n') {
            if (at_cmd_pos > 0) {
                at_cmd_buffer[at_cmd_pos] = '\0';
                at_process_command(at_cmd_buffer);
                at_cmd_pos = 0;
            }
        } else if (at_cmd_pos < (AT_CMD_BUFFER_SIZE - 1)) {
            at_cmd_buffer[at_cmd_pos++] = c;
        }
    }
}

/* Initialize AT command interface */
int at_commands_init(void)
{
    /* Get UART device for AT commands */
    at_uart = DEVICE_DT_GET(DT_CHOSEN(zephyr_console));
    if (!device_is_ready(at_uart)) {
        printk("AT UART device not ready\n");
        return -1;
    }
    
    /* Configure UART callback */
    uart_irq_callback_set(at_uart, at_uart_callback);
    uart_irq_rx_enable(at_uart);
    
    /* Send ready message */
    k_sleep(K_MSEC(100));
    at_send_response(AT_READY);
    
    printk("AT Command interface initialized on UART1\n");
    return 0;
}
```

## src/at_shell_commands.c
```c
/*
 * Shell commands for AT interface testing
 */

#include <zephyr/shell/shell.h>
#include <zephyr/net/net_if.h>
#include <zephyr/net/wifi_mgmt.h>
#include <zephyr/net/socket.h>
#include <zephyr/net/dns_resolve.h>
#include <string.h>
#include <stdio.h>

/* Simple Base64 decode table */
static const char base64_chars[] = "ABCDEFGHIJKLMNOPQRSTUVWXYZabcdefghijklmnopqrstuvwxyz0123456789+/";

/* Simple Base64 decode function */
static int base64_decode(const char *input, char *output, size_t output_size)
{
    int len = strlen(input);
    int i, j = 0;
    int pad = 0;
    
    if (len % 4 != 0) return -1;
    
    for (i = 0; i < len && j < output_size - 1; i += 4) {
        int a = strchr(base64_chars, input[i]) - base64_chars;
        int b = strchr(base64_chars, input[i+1]) - base64_chars;
        int c = (input[i+2] == '=') ? 0 : strchr(base64_chars, input[i+2]) - base64_chars;
        int d = (input[i+3] == '=') ? 0 : strchr(base64_chars, input[i+3]) - base64_chars;
        
        if (input[i+2] == '=') pad++;
        if (input[i+3] == '=') pad++;
        
        int combined = (a << 18) | (b << 12) | (c << 6) | d;
        
        output[j++] = (combined >> 16) & 0xFF;
        if (pad < 2) output[j++] = (combined >> 8) & 0xFF;
        if (pad < 1) output[j++] = combined & 0xFF;
    }
    
    output[j] = '\0';
    return j;
}

/* AT+WIFICONN shell command */
static int cmd_at_wificonn(const struct shell *sh, size_t argc, char **argv)
{
    if (argc != 3) {
        shell_error(sh, "Usage: AT+WIFICONN <ssid> <password>");
        return -EINVAL;
    }
    
    const char *ssid = argv[1];
    const char *password = argv[2];
    
    struct net_if *iface = net_if_get_first_wifi();
    if (!iface) {
        shell_error(sh, "No WiFi interface found");
        return -ENODEV;
    }
    
    struct wifi_connect_req_params params = {
        .ssid = ssid,
        .ssid_length = strlen(ssid),
        .psk = password,
        .psk_length = strlen(password),
        .security = WIFI_SECURITY_TYPE_PSK,
        .channel = WIFI_CHANNEL_ANY,
    };
    
    int ret = net_mgmt(NET_REQUEST_WIFI_CONNECT, iface, &params, sizeof(params));
    if (ret == 0) {
        shell_print(sh, "+WIFICONN:CONNECTING");
        shell_print(sh, "OK");
    } else {
        shell_error(sh, "ERROR: WiFi connect failed (%d)", ret);
    }
    
    return ret;
}

/* AT+WIFISTATUS shell command */
static int cmd_at_wifistatus(const struct shell *sh, size_t argc, char **argv)
{
    struct net_if *iface = net_if_get_first_wifi();
    if (!iface) {
        shell_error(sh, "No WiFi interface found");
        return -ENODEV;
    }
    
    struct wifi_iface_status status = {0};
    int ret = net_mgmt(NET_REQUEST_WIFI_IFACE_STATUS, iface, &status, sizeof(status));
    
    if (ret == 0) {
        if (status.state >= WIFI_STATE_ASSOCIATED) {
            shell_print(sh, "+WIFISTATUS:CONNECTED,%s,%d", status.ssid, status.rssi);
        } else {
            shell_print(sh, "+WIFISTATUS:DISCONNECTED");
        }
        shell_print(sh, "OK");
    } else {
        shell_error(sh, "ERROR: Status request failed (%d)", ret);
    }
    
    return ret;
}

/* Simple test command */
static int cmd_test_args(const struct shell *sh, size_t argc, char **argv)
{
    shell_print(sh, "Test command - argc=%d", argc);
    for (int i = 0; i < argc; i++) {
        shell_print(sh, "argv[%d]='%s'", i, argv[i]);
    }
    return 0;
}

/* AT+HTTPGET shell command with Base64 decoding */
static int cmd_at_httpget(const struct shell *sh, size_t argc, char **argv)
{
    if (argc < 2) {
        shell_error(sh, "Usage: AT+HTTPGET <base64_encoded_url>");
        shell_print(sh, "Example: echo -n 'http://google.com' | base64");
        return -EINVAL;
    }
    
    /* Decode Base64 URL */
    static char decoded_url[512];
    int decoded_len = base64_decode(argv[1], decoded_url, sizeof(decoded_url));
    
    if (decoded_len < 0) {
        shell_error(sh, "ERROR: Invalid Base64 encoding");
        return -EINVAL;
    }
    
    const char *url = decoded_url;
    shell_print(sh, "HTTP GET: %s", url);
    
    /* Simple HTTP GET implementation */
    int sock;
    struct sockaddr_in addr;
    char request[512];
    char response[1024];
    
    /* Parse URL to get host, port and path */
    char host[128] = {0};
    char path[256] = "/";
    int port = 80;
    
    /* Simple URL parsing - assumes http://host:port/path format */
    if (strncmp(url, "http://", 7) == 0) {
        const char *host_start = url + 7;
        const char *path_start = strchr(host_start, '/');
        const char *port_start = strchr(host_start, ':');
        
        if (path_start) {
            strncpy(path, path_start, sizeof(path) - 1);
        }
        
        /* Extract host and port */
        if (port_start && (!path_start || port_start < path_start)) {
            /* Host with port */
            strncpy(host, host_start, port_start - host_start);
            port = atoi(port_start + 1);
        } else if (path_start) {
            /* Host without port */
            strncpy(host, host_start, path_start - host_start);
        } else {
            /* Just host */
            strncpy(host, host_start, sizeof(host) - 1);
        }
    } else {
        shell_error(sh, "ERROR: Invalid URL format");
        return -EINVAL;
    }
    
    shell_print(sh, "Host: %s, Port: %d, Path: %s", host, port, path);
    
    /* Create socket */
    sock = socket(AF_INET, SOCK_STREAM, IPPROTO_TCP);
    if (sock < 0) {
        shell_error(sh, "ERROR: Socket creation failed");
        return -errno;
    }
    
    /* Setup address */
    addr.sin_family = AF_INET;
    addr.sin_port = htons(port);
    
    /* Try to parse as IP address first */
    if (inet_pton(AF_INET, host, &addr.sin_addr) <= 0) {
        /* Not an IP address, try DNS resolution */
        shell_print(sh, "Resolving hostname: %s", host);
        
        struct zsock_addrinfo hints = {0};
        struct zsock_addrinfo *result;
        
        hints.ai_family = AF_INET;
        hints.ai_socktype = SOCK_STREAM;
        
        int dns_ret = zsock_getaddrinfo(host, NULL, &hints, &result);
        if (dns_ret != 0 || !result) {
            close(sock);
            shell_error(sh, "+HTTPGET:DNS_FAILED");
            shell_error(sh, "ERROR: DNS resolution failed for %s", host);
            return -EINVAL;
        }
        
        /* Copy the resolved IP address */
        struct sockaddr_in *resolved_addr = (struct sockaddr_in *)result->ai_addr;
        addr.sin_addr = resolved_addr->sin_addr;
        
        char ip_str[INET_ADDRSTRLEN];
        inet_ntop(AF_INET, &addr.sin_addr, ip_str, sizeof(ip_str));
        shell_print(sh, "Resolved to IP: %s", ip_str);
        
        zsock_freeaddrinfo(result);
    }
    
    /* Connect */
    if (connect(sock, (struct sockaddr *)&addr, sizeof(addr)) < 0) {
        close(sock);
        shell_error(sh, "+HTTPGET:CONNECT_FAILED");
        shell_error(sh, "ERROR: Connection failed");
        return -errno;
    }
    
    /* Send HTTP request */
    snprintf(request, sizeof(request),
            "GET %s HTTP/1.1\r\n"
            "Host: %s\r\n"
            "Connection: close\r\n"
            "\r\n", path, host);
    
    if (send(sock, request, strlen(request), 0) < 0) {
        close(sock);
        shell_error(sh, "ERROR: Send failed");
        return -errno;
    }
    
    /* Receive response with multiple recv calls */
    int total_bytes = 0;
    int bytes;
    
    /* Receive data in chunks */
    while (total_bytes < sizeof(response) - 1) {
        bytes = recv(sock, response + total_bytes, sizeof(response) - 1 - total_bytes, 0);
        if (bytes <= 0) {
            break; /* Connection closed or error */
        }
        total_bytes += bytes;
        
        /* Small delay to allow more data */
        k_msleep(10);
    }
    
    close(sock);
    
    if (total_bytes > 0) {
        response[total_bytes] = '\0';
        
        shell_print(sh, "Total received: %d bytes", total_bytes);
        
        /* Find the end of HTTP headers (\r\n\r\n) */
        char *body_start = strstr(response, "\r\n\r\n");
        if (body_start) {
            body_start += 4; /* Skip past \r\n\r\n */
            shell_print(sh, "+HTTPGET:200,%d", strlen(body_start));
            shell_print(sh, "Response Body: '%s'", body_start);
        } else {
            shell_print(sh, "+HTTPGET:200,%d", total_bytes);
            shell_print(sh, "Full Response: %s", response);
        }
        shell_print(sh, "OK");
    } else {
        shell_error(sh, "ERROR: No data received");
        return -errno;
    }
    
    return 0;
}

/* Simple network info command */
static int cmd_net_info(const struct shell *sh, size_t argc, char **argv)
{
    shell_print(sh, "Network Information:");
    
    struct net_if *iface = net_if_get_first_wifi();
    if (iface) {
        char buf[NET_IPV4_ADDR_LEN];
        struct in_addr *addr = net_if_ipv4_get_global_addr(iface, NET_ADDR_PREFERRED);
        if (addr) {
            shell_print(sh, "IP: %s", net_addr_ntop(AF_INET, addr, buf, sizeof(buf)));
        } else {
            shell_print(sh, "No IP address assigned");
        }
        
        shell_print(sh, "Interface up: %s", net_if_is_up(iface) ? "Yes" : "No");
    }
    
    return 0;
}

/* Register individual shell commands */
SHELL_CMD_REGISTER(test_args, NULL, "Test arguments", cmd_test_args);
SHELL_CMD_REGISTER(net_info, NULL, "Show network info", cmd_net_info);
SHELL_CMD_REGISTER(at_wificonn, NULL, "AT+WIFICONN <ssid> <password>", cmd_at_wificonn);
SHELL_CMD_REGISTER(at_wifistatus, NULL, "AT+WIFISTATUS", cmd_at_wifistatus);
SHELL_CMD_REGISTER(at_httpget, NULL, "AT+HTTPGET <base64_url>", cmd_at_httpget);
```
